/*
 * Copyright (c) 2022 The ZMK Contributors
 *
 *
 * SPDX-License-Identifier: MIT
 */

#include <behaviors.dtsi>
#include <dt-bindings/zmk/keys.h>
#include <dt-bindings/zmk/bt.h>
#include <dt-bindings/zmk/outputs.h>

/ {
keymap {
        compatible = "zmk,keymap";

        default_layer {
            bindings = <
                &kp O
                &kp H
                &kp C
                &kp D
                &kp E
                &kp L
                &kp S
                &kp H
                &kp I
                &kp F
                &kp K
                &kp D
                &kp M
                &kp N
                &bt BT_CLR
                &kp K
                &kp Q
                &kp J
            >;
        };
    };
};
